## boards/esp32c6-devkit/Kconfig
```kconfig
# Copyright (c) 2020 HAW Hamburg
#               2022 Gunar Schorcht
#
# This file is subject to the terms and conditions of the GNU Lesser
# General Public License v2.1. See the file LICENSE in the top level
# directory for more details.

config BOARD
    default "esp32c6-devkit" if BOARD_ESP32C6_DEVKIT

config BOARD_ESP32C6_DEVKIT
    bool
    default y
    select BOARD_COMMON_ESP32C6
    select CPU_MODEL_ESP32C6_MINI_1X

source "$(RIOTBOARD)/common/esp32c6/Kconfig"
```

## boards/rpi-pico-2/Kconfig
```kconfig
# Copyright (C) 2021 Otto-von-Guericke-Universität Magdeburg
#
# This file is subject to the terms and conditions of the GNU Lesser
# General Public License v2.1. See the file LICENSE in the top level
# directory for more details.
#

config BOARD
    default "rpi-pico-2" if BOARD_RPI_PICO_2

config BOARD_RPI_PICO_2
    bool
    default y
    select CPU_MODEL_RP2350
```

## cpu/rp2350_riscv/Kconfig
```kconfig
# SPDX-FileCopyrightText: 2025 Tom Hert <git@annsann.eu>
# SPDX-FileCopyrightText: 2025 HAW Hamburg
# SPDX-License-Identifier: LGPL-2.1-only

config CPU_FAM_RP2350_RISCV
    bool
    select CPU_CORE_RV32IMAC

config CPU_FAM
    default "RP2350_RISCV" if CPU_FAM_RP2350_RISCV

config CPU_MODEL_RP2350_RISCV
    bool
    select CPU_FAM_RP2350_RISCV

config CPU_MODEL
    default "RP2350_RISCV" if CPU_MODEL_RP2350_RISCV

config CPU
    default "rp2350_riscv" if CPU_FAM_RP2350_RISCV


source "$(RIOTCPU)/riscv_common/Kconfig"
```

## cpu/rp23xx/Kconfig
```kconfig
# Copyright (C) 2021 Otto-von-Guericke-Universität Magdeburg
#
# This file is subject to the terms and conditions of the GNU Lesser
# General Public License v2.1. See the file LICENSE in the top level
# directory for more details.
#

config CPU_FAM_RP23XX
    bool
    select CPU_CORE_CORTEX_M33

config CPU_FAM
    default "RP23XX" if CPU_FAM_RP23XX

source "$(RIOTCPU)/cortexm_common/Kconfig"
```
